;
; ADC_Switch_Between_Auto_Trigger.asm
;
; Created: 10/3/2023 2:25:11 PM
; Author : Options
;


; Replace with your application code
.INCLUDE "m32def.inc"

.ORG 0x00
JMP MAIN

.ORG 0x02
JMP INT0_ISR

.ORG 0x50
MAIN:
LDI R16,HIGH(RAMEND)
OUT SPH,R16
LDI R16,LOW(RAMEND)
OUT SPL,R16

LDI R16,0xFF
OUT DDRB,R16
OUT DDRC,R16
CBI DDRA,PA0
CBI DDRD,PD2
SBI PORTD,PD2
SBI DDRD,PD6


LDI R16,0x02
OUT MCUCR,R16
LDI R16,0x40
OUT GICR,R16

OUT ADMUX,R16
OUT SFIOR,R16
LDI R16,0xA6
OUT ADCSRA,R16
SEI

HERE:
SBIS ADCSRA,ADIF
RJMP HERE
IN R16,ADCL
OUT PORTB,R16
IN R16,ADCH
OUT PORTC,R16

LDI R16,0x04
OUT SFIOR,R16
K:
SBIS PIND,PD2
RJMP K

SBI ADCSRA,ADSC
L:
SBIS ADCSRA,ADIF
RJMP L

IN R16,ADCL
OUT PORTB,R16
IN R16,ADCH
OUT PORTC,R16

LOOP:
IN R17,ADCSRA
OUT PORTD,R17
RJMP LOOP

.ORG 0x200
INT0_ISR:
RETI



