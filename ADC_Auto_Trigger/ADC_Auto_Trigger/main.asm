;
; ADC_Auto_Trigger.asm
;
; Created: 10/3/2023 12:14:10 PM
; Author : Options
;


; Replace with your application code
.INCLUDE "m32def.inc"

.ORG 0x00
JMP MAIN

.ORG 0x02
JMP INT0_ISR

.ORG 0x20
JMP ADC_ISR

.ORG 0x50
MAIN:
LDI R16,HIGH(RAMEND)
OUT SPH,R16
LDI R16,LOW(RAMEND)
OUT SPL,R16

LDI R16,0xFF
OUT DDRB,R16
OUT DDRC,R16
CBI DDRA,PA0
CBI DDRD,PD2
SBI PORTD,PD2

LDI R16,0x02
OUT MCUCR,R16
LDI R16,0x40
OUT GICR,R16

OUT ADMUX,R16
OUT SFIOR,R16
LDI R16,0xAE
OUT ADCSRA,R16
SEI
LOOP: RJMP LOOP

.ORG 0x200
INT0_ISR:
RETI

ADC_ISR:
IN R16,ADCL
OUT PORTB,R16
IN R16,ADCH
OUT PORTC,R16
RETI









